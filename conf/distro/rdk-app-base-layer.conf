## conf/distro/rdk-app-base-layer.conf
```bitbake
require conf/distro/defaultsetup.conf

DISTRO = "rdk-app-base-layer"
DISTRO_NAME = "RDK App Base Layer"
DISTRO_VERSION = "1.0"
SDK_VENDOR = "-rdk_app_base_sdk"
SDK_VERSION = "${@d.getVar('DISTRO_VERSION').replace('snapshot-${METADATA_REVISION}', 'snapshot')}"
SDK_VERSION[vardepvalue] = "${SDK_VERSION}"


# Use glibc as the main lib
TCLIBC = "glibc"


# Build optimised for size
FULL_OPTIMIZATION="-Os -pipe ${DEBUG_FLAGS}"


# Don't want to build a kernel, just a rootfs, so the following disables
# the kernel build.
PREFERRED_PROVIDER_virtual/kernel = "linux-dummy"
PREFERRED_VERSION_linux-dummy ?= "5.15.%"


# Enable Wayland / EGL / GLES support
DISTRO_FEATURES = "wayland \
                   egl \
                   opengles2 \
                  "

# Build the roofs as a tarball rather than cpio
# TODO: Replace this with generating a OCI package
IMAGE_FSTYPES = "tar.gz"

# Disable all device and init managers
VIRTUAL-RUNTIME_init_manager = ""
VIRTUAL-RUNTIME_initscripts = ""
VIRTUAL-RUNTIME_login_manager = ""
VIRTUAL-RUNTIME_dev_manager = ""
INIT_MANAGER ?= "none"

VIRTUAL-RUNTIME_base-utils-hwclock = ""
VIRTUAL-RUNTIME_base-utils-syslog = ""

PREFERRED_PROVIDER_virtual/egl = "khronos-stubs"
PREFERRED_PROVIDER_virtual/libgles1 = "khronos-stubs"
PREFERRED_PROVIDER_virtual/libgles2 = "khronos-stubs"
PREFERRED_PROVIDER_virtual/libgles3 = "khronos-stubs"


# Pretend to use devtmpfs, which means the /dev directory will not be populated,
# which is what we want as the container will populate it.
# USE_DEVFS = "1"
```

## conf/distro/rdke-appsdk.conf
```bitbake
DISTRO = "rdke-appsdk"
DISTRO_NAME = "RDK-E AppSDK and Base Layer Distro"
DISTRO_VERSION = "1.0"
SDK_VENDOR = "-rdke_appsdk"
SDK_VERSION = "${@d.getVar('DISTRO_VERSION').replace('snapshot-${METADATA_REVISION}', 'snapshot')}"
SDK_VERSION[vardepvalue] = "${SDK_VERSION}"

# Use glibc as the main lib
TCLIBC = "glibc"

# Build optimised for size
FULL_OPTIMIZATION="-Os -pipe ${DEBUG_FLAGS}"

# Don't need to build and add the linux kernel, just userland rootfs images, this removes kernel from image
# But apparently still need to set linux-dummy to statify code in image-container.bbclass. Minor TODO to FIX that class.
PREFERRED_PROVIDER_virtual/kernel = "linux-dummy"
IMAGE_INSTALL:remove = "virtual/kernel"

# Important to agree lowest Linux UAPI version to be compatible with. 
# UAPI is the kernel's offical contract with user space
# linux-libc-headers is package that provides the exported UAPI headers from a given kernel version
# RTAB WG to decide what minimum version needs to be
# Standard poky kirkstone only has headers for 5.16.
# TODO can only set version to 4.9/5.4/5.15 when associated recipe is available, like linux-libc-headers_5.4.bb
# Current AppSDK OSS manifest with standard poky kirkstone only has headers for 5.16.
# need to add for linux-libc-headers_5.4.bb from 
# for example https://github.com/rdkcentral/meta-rdk-oss-reference/tree/develop/recipes-kernel/linux-libc-headers
# TODO Clarify Impact of Android Common Kernel Version variant on this ?

# LINUXLIBCVERSION = "5.15%"
PREFERRED_VERSION_linux-libc-headers = "5.15%"

# Enable Wayland / EGL / GLES support
DISTRO_FEATURES = "wayland egl opengles2 "

# Do not auto add those through backfill
DISTRO_FEATURES_BACKFILL_CONSIDERED += " sysvinit pulseaudio"

# Potential TODO: move PREFERRED_VERSION_x statements to dedicated preferred_version.inc file
# Potential TODO: move PREFERRED_PROVIDER_x statements to dedicated preferred_provider.inc file 

# Build the rootfs as a tarball rather than cpio
IMAGE_FSTYPES = "tar.gz"

# Disable all device and init managers
VIRTUAL-RUNTIME_init_manager = ""
VIRTUAL-RUNTIME_initscripts = ""
VIRTUAL-RUNTIME_login_manager = ""
VIRTUAL-RUNTIME_dev_manager = ""
INIT_MANAGER = "none"

VIRTUAL-RUNTIME_base-utils-hwclock = ""
VIRTUAL-RUNTIME_base-utils-syslog = ""

PREFERRED_PROVIDER_virtual/egl = "khronos-stubs"
PREFERRED_PROVIDER_virtual/libgles1 = "khronos-stubs"
PREFERRED_PROVIDER_virtual/libgles2 = "khronos-stubs"
PREFERRED_PROVIDER_virtual/libgles3 = "khronos-stubs"

#for now assuming busybox as shell and util provider in standard base layer profile.
#REVIEW we could consider alternative like dash from oe-core, also used in meta-dac-sdk and only use busybox in debug extension base layer profile
PREFERRED_PROVIDER_virtual/sh = "busybox"
PREFERRED_PROVIDER_virtual/base-utils = "busybox"


# Pretend to use devtmpfs, which means the /dev directory will not be populated,
# which is what we want as the container will populate it.
# USE_DEVFS = "1"
```

## conf/layer.conf
```bitbake
# We have a conf and classes directory, add to BBPATH
BBPATH .= ":${LAYERDIR}"

# We have recipes-* directories, add to BBFILES
BBFILES += "${LAYERDIR}/recipes-*/*/*.bb \
            ${LAYERDIR}/recipes-*/*/*.bbappend"

BBFILE_COLLECTIONS += "rdk-app-sdk-base-dev"
BBFILE_PATTERN_rdk-app-sdk-base-dev = "^${LAYERDIR}/"
BBFILE_PRIORITY_rdk-app-sdk-base-dev = "6"

LAYERDEPENDS_rdk-app-sdk-base-dev = "core"
LAYERSERIES_COMPAT_rdk-app-sdk-base-dev = "kirkstone"
```

## conf/machine/arm.conf
```bitbake
#TYPE: Machine
#@NAME: arm   
#@DESCRIPTION: "arm" is arm32 in containerland - GOARCH / OCI name
#@DESCRIPTION: arm 32bit CPU arch ABI agreed for Applications build with RDK platform agnostic App SDK
#@DESCRIPTION:     is TUNE = "armv7athf-neon" armv7a with neon, thumb2, little endian  ABI and agreed specific machine
#@DESCRIPTION:     see AVAILTUNES in https://github.com/yoctoproject/poky/blob/kirkstone/meta/conf/machine/include/arm/arch-armv7a.inc#L53
#@DESCRIPTION:     same as already defined in RDK OSS layer arch see https://github.com/rdkcentral/meta-oss-reference-development/blob/develop/conf/machine/rdk-arm7a.conf
#@DESCRPTION:      compatible with armeabi-v7a as used in android  see https://developer.android.com/ndk/guides/abis#v7a
#@DESCRPTION:      except for RDK we choose industry common hard-float. Unlike android we have no old, historical soft float legacy to be backwards compatible with.
#@DESCRPTION:      TODO : question what about TUNE vfpv3 versus vfpv4 ?

require conf/machine/include/arm/arch-armv7a.inc 
DEFAULTTUNE = "armv7athf-neon"

#Machine overrides
MACHINEOVERRIDES .= ":arm"
MACHINEOVERRIDES .= ":kirkstone"

# TODO : below is in OSS config. Check if needed. Uncommenting for now 
# MACHINEOVERRIDES .= ":client:rdkzram"
```

## conf/machine/rdk-arm32on64.conf
```bitbake
#TYPE: Machine
#@NAME: rdk-arm32on64
#@DESCRIPTION: arm 32bit userland on arm 64bit kernel CPU arch ABI agreed for Applications build with RDK platform agnostic App SDK
#@DESCRIPTION:     for 32bit userland is TUNE = "armv7vethf-neon" armv7ve with neon, thumb2, little endian  ABI and agreed specific machine
#@DESCRIPTION:     see AVAILTUNES in https://github.com/yoctoproject/poky/blob/kirkstone/meta/conf/machine/include/arm/arch-armv7ve.inc
#@DESCRIPTION:     same as already defined in RDK OSS layer arch see https://github.com/rdkcentral/meta-oss-reference-development/blob/develop/conf/machine/rdk-arm64.conf#L11
#@DESCRIPTION:     for 64bit TUNE = "armv8a-crc"
#@DESCRIPTION:     see AVAILTUNES in https://github.com/yoctoproject/poky/blob/kirkstone/meta/conf/machine/include/arm/arch-armv8a.inc#L12
#@DESCRIPTION:     similar as already defined in RDK OSS layer arch see https://github.com/rdkcentral/meta-oss-reference-development/blob/develop/conf/machine/rdk-arm64.conf#L18

require conf/machine/include/arm/arch-armv8a.inc
# default tune in above arch-armv8a.inc is DEFAULTTUNE ?= "armv8a-crc"
# assigning strict iso weak 
DEFAULTTUNE = "armv8a-crc"

# support required 32-bit ARMv7VE as multilib target
require conf/multilib.conf
MULTILIBS = "multilib:lib32"
DEFAULTTUNE:virtclass-multilib-lib32 = "armv7vethf-neon"

MACHINEOVERRIDES .= ":mixmode"
DISTRO_FEATURES:append = " mixmode"

# TODO : below is in OSS config. Check if needed. Uncommenting for now 
# LINUXLIBCVERSION = "5.4%"
```

## meta-bolt-base/conf/distro/rdke-appsdk.conf
```bitbake
DISTRO = "rdke-appsdk"
DISTRO_NAME = "RDK-E AppSDK and Base Layer Distro"
DISTRO_VERSION = "1.0"
SDK_VENDOR = "-rdke_appsdk"
SDK_VERSION = "${@d.getVar('DISTRO_VERSION').replace('snapshot-${METADATA_REVISION}', 'snapshot')}"
SDK_VERSION[vardepvalue] = "${SDK_VERSION}"

INCOMPATIBLE_LICENSE = "LGPL-3.0-or-later LGPL-3.0-only GPL-3.0-or-later GPL-3.0-only"
# TODO P3 clarify with legal if we cannot set this INCOMPATIBLE_LICESE at yocto image level as recommend by yocto community iso setting it global at distro level
# global setting has drawback that it requires older gplv2 versions of bash, gdbm and readline while not used in base-layer 

#For test, debug purpose only, Enable following distro feature to enable newer versions of tar, gdb. These come with GPLv3 license, cannot use in prod
#DISTRO_FEATURES:append = " build_debug_purpose_gplv3"
INCOMPATIBLE_LICENSE_EXCEPTIONS += "${@bb.utils.contains('DISTRO_FEATURES','build_debug_purpose_gplv3', '${MLPREFIX}tar:GPL-3.0-only ${MLPREFIX}gdbserver:GPL-3.0-only ${MLPREFIX}gdbserver:LGPL-3.0-only ${MLPREFIX}gdb:GPL-3.0-only ${MLPREFIX} gdb:LGPL-3.0-only ${MLPREFIX}binutils:GPL-3.0-only ${MLPREFIX}libbfd:GPL-3.0-only', '', d)}"


# Use glibc as the main lib
TCLIBC = "glibc"

# Build optimised for size
FULL_OPTIMIZATION="-Os -pipe ${DEBUG_FLAGS}"

# Don't need to build and add the linux kernel, just userland rootfs images, this removes kernel from image
# But apparently still need to set linux-dummy to statify code in image-container.bbclass. Minor TODO to FIX that class.
PREFERRED_PROVIDER_virtual/kernel = "linux-dummy"
IMAGE_INSTALL:remove = "virtual/kernel"

# Important to agree lowest Linux UAPI version to be compatible with. 
# UAPI is the kernel's offical contract with user space
# linux-libc-headers is package that provides the exported UAPI headers from a given kernel version
# RTAB WG to decide what minimum version needs to be
# Standard poky kirkstone only has headers for 5.16.
# TODO can only set version to 4.9/5.4/5.15 when associated recipe is available, like linux-libc-headers_5.4.bb
# Current AppSDK OSS manifest with standard poky kirkstone only has headers for 5.16.
# need to add for linux-libc-headers_5.4.bb from 
# for example https://github.com/rdkcentral/meta-rdk-oss-reference/tree/develop/recipes-kernel/linux-libc-headers
# TODO Clarify Impact of Android Common Kernel Version variant on this ?

# LINUXLIBCVERSION = "5.15%"
PREFERRED_VERSION_linux-libc-headers = "5.15%"

# Enable Wayland / EGL / GLES support
DISTRO_FEATURES = "wayland egl opengles2 "

# Do not auto add those through backfill
DISTRO_FEATURES_BACKFILL_CONSIDERED += " sysvinit pulseaudio"

# Potential TODO: move PREFERRED_VERSION_x statements to dedicated preferred_version.inc file
# Potential TODO: move PREFERRED_PROVIDER_x statements to dedicated preferred_provider.inc file 

# Build the rootfs as a tarball rather than cpio
IMAGE_FSTYPES = "tar.gz"

# Disable all device and init managers
VIRTUAL-RUNTIME_init_manager = ""
VIRTUAL-RUNTIME_initscripts = ""
VIRTUAL-RUNTIME_login_manager = ""
VIRTUAL-RUNTIME_dev_manager = ""
INIT_MANAGER = "none"

VIRTUAL-RUNTIME_base-utils-hwclock = ""
VIRTUAL-RUNTIME_base-utils-syslog = ""

PREFERRED_PROVIDER_virtual/egl = "khronos-stubs"
PREFERRED_PROVIDER_virtual/libgles1 = "khronos-stubs"
PREFERRED_PROVIDER_virtual/libgles2 = "khronos-stubs"
PREFERRED_PROVIDER_virtual/libgles3 = "khronos-stubs"

#for now assuming busybox as shell and util provider in standard base layer profile.
#REVIEW we could consider alternative like dash from oe-core, also used in meta-dac-sdk and only use busybox in debug extension base layer profile
PREFERRED_PROVIDER_virtual/sh = "busybox"
PREFERRED_PROVIDER_virtual/base-utils = "busybox"


# Pretend to use devtmpfs, which means the /dev directory will not be populated,
# which is what we want as the container will populate it.
# USE_DEVFS = "1"
```

## meta-bolt-base/conf/layer.conf
```bitbake
# We have a conf and classes directory, add to BBPATH
BBPATH .= ":${LAYERDIR}"

# We have recipes-* directories, add to BBFILES
BBFILES += "${LAYERDIR}/recipes-*/*/*.bb \
            ${LAYERDIR}/recipes-*/*/*.bbappend \
            ${LAYERDIR}/meta-*/recipes-*/*/*.bbappend \
            ${LAYERDIR}/meta/recipes*/*/*.bbappend"

BBFILE_COLLECTIONS += "bolt-base"
BBFILE_PATTERN_bolt-base = "^${LAYERDIR}/"
BBFILE_PRIORITY_bolt-base = "6"

LAYERDEPENDS_bolt-base = "core"
LAYERSERIES_COMPAT_bolt-base = "kirkstone"
```

## meta-bolt-base/conf/machine/amd64.conf
```bitbake
#TYPE: Machine
#@NAME: amd64
#@DESCRIPTION: "amd64" is arm64 in containerland - GOARCH / OCI name
#@DESCRIPTION: x86 64bit CPU arch ABI agreed for Applications build with RDK platform agnostic App SDK
#@DESCRIPTION:     is TUNE = "core2-64"  based on what RDK vdevice uses. RDK vdevice uses qemux86-64
#@DESCRIPTION:     and qemux86-64 uses DEFAULTTUNE ?= "core2-64" from https://github.com/yoctoproject/poky/blob/kirkstone/meta/conf/machine/include/x86/tune-core2.inc#L26 
#@DESCRIPTION:     see https://github.com/yoctoproject/poky/blob/kirkstone/meta/conf/machine/qemux86-64.conf#L12
#@DESCRIPTION:     Android x86_64 abi supports more instruction set extensions see https://developer.android.com/ndk/guides/abis#86-64 
#@DESCRIPTION:        and that tune config would be more like DEFAULTTUNE ?= "corei7-64" 
#@DESCRIPTION:        see https://github.com/yoctoproject/poky/blob/kirkstone/meta/conf/machine/include/x86/tune-corei7.inc#L26
#@DESCRIPTION:        I hear that this should be supported on PC CPU's from Intel and AMD as of 2012 so worth to switch to that after discussion and agreement

require conf/machine/include/x86/tune-core2.inc
DEFAULTTUNE = "core2-64"

MACHINE_FEATURES += " x86"
```

## meta-bolt-base/conf/machine/arm64.conf
```bitbake
#TYPE: Machine
#@NAME: arm64
#@DESCRIPTION: "arm64" is arm64 in containerland - GOARCH / OCI name
#@DESCRIPTION: arm 64bit pure, both userland and kernel in 64bit CPU arch ABI agreed for Applications build with RDK platform agnostic App SDK
#@DESCRIPTION:     for 64bit TUNE = "armv8a-crc"
#@DESCRIPTION:     see AVAILTUNES in https://github.com/yoctoproject/poky/blob/kirkstone/meta/conf/machine/include/arm/arch-armv8a.inc#L12
#@DESCRPTION:      compatible with arm64-v8a as used in android  see https://developer.android.com/ndk/guides/abis#arm64-v8a NEON should be in use by DEFAULTTUNE

require conf/machine/include/arm/arch-armv8a.inc
# Primary 64-bit tune, in above arch-armv8a.inc DEFAULTTUNE ?= "armv8a-crc"  
# uncomment below if you want force iso weak assign the DEFAULTTUNE
DEFAULTTUNE = "armv8a-crc"

# TODO Is it required to explicitly enable NEON, would think not for armv8 
# TUNE_FEATURES += "neon"

#Machine overrides
MACHINEOVERRIDES .= ":arm64"
MACHINEOVERRIDES .= ":kirkstone"
```
